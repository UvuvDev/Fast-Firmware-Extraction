/dts-v1/;
/plugin/;

/ {
    fragment@0 {
        target-path = "/";
        __overlay__ {
            fixture-a {
                compatible = "firmware-unpack,fixture-a";
                test-value = <0x12345678>;
            };
        };
    };
};
