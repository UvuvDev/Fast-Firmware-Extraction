/dts-v1/;
/plugin/;

/ {
    fragment@0 {
        target-path = "/";
        __overlay__ {
            fixture-b {
                compatible = "firmware-unpack,fixture-b";
                test-values = <0xabcdef01 0x23456789>;
                description = "Second independently compiled test overlay";
            };
        };
    };
};
